## conf/machine/mini2440.conf
```bitbake
#@TYPE: Machine
#@NAME: mini2440

#@DESCRIPTION: Machine configuration for mini2440 systems

#PREFERRED_PROVIDER_virtual/xserver ?= "xserver-xorg"
#XSERVER ?= "xserver-xorg \
#           xf86-input-evdev \
#           xf86-input-mouse \
#           xf86-video-omapfb \
#           xf86-input-keyboard"

# Ship all kernel modules by default
MACHINE_EXTRA_RRECOMMENDS = " kernel-modules"

# Allow for MMC booting (required by the NAND-less Beagleboard XM)
EXTRA_IMAGEDEPENDS += "u-boot"

# Uncomment the following line to enable the hard floating point abi. Note that
# this breaks some binary libraries and 3D (neither of which ship with
# meta-yocto). For maximum compatibility, leave this disabled.
#DEFAULTTUNE ?= "cortexa8hf-neon"
include conf/machine/include/tune-arm920t.inc

IMAGE_FSTYPES += "tar.bz2 jffs2"
EXTRA_IMAGECMD_jffs2 = "-lnp "

# 2.6.37 and later kernels use OMAP_SERIAL, ttyO2
# earlier kernels use ttyS2
USE_VT = "1"
SERIAL_CONSOLE = "115200 ttySAC0"
#APPEND = "console=ttySAC0,115200"

PREFERRED_PROVIDER_virtual/kernel ?= "linux-yocto"
PREFERRED_VERSION_linux-yocto ?= "3.10%"

KERNEL_IMAGETYPE = "uImage"
#KERNEL_DEVICETREE = "${S}/arch/arm/boot/dts/omap3-beagle.dts ${S}/arch/arm/boot/dts/omap3-beagle-xm.dts"

#SPL_BINARY = "MLO"
UBOOT_SUFFIX = "bin"
UBOOT_MACHINE = "mini2440_config"
UBOOT_ENTRYPOINT = "0x80008000"
UBOOT_LOADADDRESS = "0x80008000"

MACHINE_FEATURES = "usbgadget usbhost vfat alsa"
```
